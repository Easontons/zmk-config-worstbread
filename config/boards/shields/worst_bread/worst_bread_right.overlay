/*
 * Copyright (c) 2022 The ZMK Contributors
 *
 * SPDX-License-Identifier: MIT
 */

#include "worst_bread.dtsi"

&default_transform {
	col-offset = <3>;
};

/ {
	chosen {
		zmk,kscan = &kscan0;
	};

	kscan0: kscan {
		compatible = "zmk,kscan-gpio-matrix";

		diode-direction = "row2col";

		row-gpios
			= <&pro_micro 14 GPIO_ACTIVE_HIGH>
			, <&pro_micro 16 GPIO_ACTIVE_HIGH>
			, <&pro_micro 10 GPIO_ACTIVE_HIGH>
			;

		col-gpios
			= <&pro_micro 2 (GPIO_PULL_DOWN | GPIO_ACTIVE_HIGH)>
			, <&pro_micro 3 (GPIO_PULL_DOWN | GPIO_ACTIVE_HIGH)>
			, <&pro_micro 4 (GPIO_PULL_DOWN | GPIO_ACTIVE_HIGH)>
			;
	};
};
