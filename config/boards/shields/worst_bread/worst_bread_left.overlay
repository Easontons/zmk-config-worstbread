/*
 * Copyright (c) 2022 The ZMK Contributors
 *
 * SPDX-License-Identifier: MIT
 */

#include "worst_bread.dtsi"

/ {
	chosen {
		zmk,kscan = &kscan0;
	};

	kscan0: kscan {
		compatible = "zmk,kscan-gpio-matrix";

		diode-direction = "row2col";

		row-gpios
			= <&pro_micro 5 GPIO_ACTIVE_HIGH>
			, <&pro_micro 6 GPIO_ACTIVE_HIGH>
			, <&pro_micro 7 GPIO_ACTIVE_HIGH>
			;

		col-gpios
			= <&pro_micro 2 (GPIO_PULL_DOWN | GPIO_ACTIVE_HIGH)>
			, <&pro_micro 3 (GPIO_PULL_DOWN | GPIO_ACTIVE_HIGH)>
			, <&pro_micro 4 (GPIO_PULL_DOWN | GPIO_ACTIVE_HIGH)>
			;
	};
};


