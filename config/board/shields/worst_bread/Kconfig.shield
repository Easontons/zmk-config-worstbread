## config/board/shields/worst_bread/Kconfig.shield
```kconfig
config SHIELD_WORST_BREAD_LEFT
	def_bool $(shields_list_contains,worst_bread_left)

config SHIELD_WORST_BREAD_RIGHT
	def_bool $(shields_list_contains,worst_bread_right)
```

## config/boards/shields/worst_bread/Kconfig.defconfig
```kconfig
# Copyright (c) 2023 The ZMK Contributors
# SPDX-License-Identifier: MIT

config ZMK_BLE
 	default y


if SHIELD_WORST_BREAD_DONGLE || SHIELD_WORST_BREAD_LEFT

config ZMK_KEYBOARD_NAME
	default "Worst Bread"

config ZMK_SPLIT
	default y

config ZMK_SPLIT_ROLE_CENTRAL
	default y

config_ZMK_USB
  	default y

endif # SHIELD_WORST_BREAD_DONGLE || SHIELD_WORST_BREAD_LEFT


if SHIELD_WORST_BREAD_DONGLE_LEFT || SHIELD_WORST_BREAD_DONGLE_RIGHT || SHIELD_WORST_BREAD_RIGHT

config ZMK_SPLIT
	default y

endif # SHIELD_WORST_BREAD_DONGLE_LEFT || SHIELD_WORST_BREAD_DONGLE_RIGHT || SHIELD_WORST_BREAD_RIGHT


if SHIELD_DONGLE_RESET

config ZMK_KEYBOARD_NAME
	default "DONGLE RESET"

endif
```

## config/boards/shields/worst_bread/Kconfig.shield
```kconfig
config SHIELD_WORST_BREAD_LEFT
	def_bool $(shields_list_contains,worst_bread_left)

config SHIELD_WORST_BREAD_RIGHT
	def_bool $(shields_list_contains,worst_bread_right)

config SHIELD_WORST_BREAD_DONGLE_LEFT
	def_bool $(shields_list_contains,worst_bread_dongle_left)

config SHIELD_WORST_BREAD_DONGLE_RIGHT
	def_bool $(shields_list_contains,worst_bread_dongle_right)

config SHIELD_WORST_BREAD_DONGLE
	def_bool $(shields_list_contains,worst_bread_dongle)
```

## config/west.yml
```yaml
manifest:
  remotes:
    - name: zmkfirmware
      url-base: https://github.com/Easontons
  projects:
    - name: zmk
      remote: zmkfirmware
      revision: other-sup
      import: app/west.yml
  self:
    path: config
```
